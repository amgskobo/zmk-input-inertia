## Kconfig
```kconfig
# Copyright (c) 2025-2026 amgskobo
# SPDX-License-Identifier: MIT

DT_COMPAT_ZMK_INPUT_PROCESSOR_INERTIA := zmk,input-processor-inertia

config ZMK_INPUT_PROCESSOR_INERTIA
	bool
	default $(dt_compat_enabled,$(DT_COMPAT_ZMK_INPUT_PROCESSOR_INERTIA))
	depends on ZMK_POINTING
	depends on (!ZMK_SPLIT || ZMK_SPLIT_ROLE_CENTRAL)
	select ZMK_LOW_PRIORITY_WORK_QUEUE

config ZMK_INPUT_INERTIA_LOG_LEVEL
    int "zmk-input-inertia log level (0 off, 1 error, 2 warning, 3 info, 4 debug)"
    range 0 4
    default 3
    help
      Logs contain operational state and numeric diagnostics, never input
      contents, user labels, peer addresses or authentication material.

config ZMK_INPUT_INERTIA_CUSTOM_SETTINGS
    bool "Publish inertia tuning through custom settings"
    depends on ZMK_INPUT_PROCESSOR_INERTIA
    depends on ZMK_CUSTOM_SETTINGS_STUDIO_RPC
    help
      Expose trigger, move/scroll decay, intervals, thresholds and Ctrl policy.
      The shared registry owns persistence; stock keeps the runtime API.
```

## dts/bindings/zmk,input-processor-inertia.yml
```yaml
# Copyright (c) 2025-2026 amgskobo
# SPDX-License-Identifier: MIT

description: ZMK Inertia Input Processor

compatible: "zmk,input-processor-inertia"

include: ip_zero_param.yaml

properties:
  trigger-ms:
    type: int
    default: 35
    description: |
      The delay (ms) after manual input stops before inertia starts. Must be 1-65535.
      IMPORTANT: To prevent "bouncing" or accidental triggers during manual movement,
      set this to AT LEAST TWICE the sensor's polling interval (e.g., 30ms for a 15ms sensor).

  move-decay-factor-int:
    type: int
    default: 90
    description: |
      Velocity retention percentage (0-99) per report interval.
      Higher values (e.g., 95) make the movement feel slipperier and longer-lasting.

  move-report-interval-ms:
    type: int
    default: 35
    description: |
      The time interval (ms) for calculating and sending inertia movement reports.
      Must be 1-65535.
      Matching this to your sensor's polling rate (e.g., 15ms) provides the smoothest transition.

  move-threshold-start:
    type: int
    default: 15
    description: |
      Minimum absolute delta from the last manual frame required to start inertia.
      Must be 1-32767 and greater than move-threshold-stop.
      Prevents accidental sliding from micro-gestures.

  move-threshold-stop:
    type: int
    default: 1
    description: |
      Inertia stops when both axes are at or below this value.
      Must be non-negative and less than move-threshold-start.

  scroll-decay-factor-int:
    type: int
    default: 85
    description: |
      Velocity retention percentage for scrolling (0-99).
      Higher values result in longer scrolls.

  scroll-report-interval-ms:
    type: int
    default: 65
    description: |
      The time interval (ms) for scroll inertia updates. Must be 1-65535.

  scroll-threshold-start:
    type: int
    default: 2
    description: |
      Minimum absolute scroll delta needed to activate inertia.
      Must be 1-32767 and greater than scroll-threshold-stop.

  scroll-threshold-stop:
    type: int
    default: 0
    description: |
      Scroll inertia stops when both axes are at or below this value.
      Must be non-negative and less than scroll-threshold-start.

  cancel-scroll-inertia-on-ctrl:
    type: boolean
    description: |
      When set to true, stop active scroll inertia and suppress new scroll inertia while Ctrl is pressed.
      This is useful to avoid accidental host-side zoom actions from Ctrl+wheel.
```

## tests/bsim/script/Kconfig
```kconfig
# Copyright (c) 2026 amgskobo
# SPDX-License-Identifier: MIT

config ZMK_TEST_INPUT_SCRIPT
	bool
	default y
	depends on DT_HAS_ZMK_TEST_INPUT_SCRIPT_ENABLED
	depends on INPUT
```

## tests/bsim/script/dts/bindings/zmk,test-input-script.yaml
```yaml
# Copyright (c) 2026 amgskobo
# SPDX-License-Identifier: MIT

description: |
  Test-only input device that replays a script of events. Each entry waits its
  delay after the entry before it (the first, after boot), then reports its
  event; entries with a delay of 0 go out together with the one before.

  An entry of type 254 is a glide, (period 254 steps x y): steps frames, one
  every period ms, moving an ABS_X/ABS_Y contact in a straight line from the
  last reported position to (x, y).

compatible: "zmk,test-input-script"

properties:
  events:
    type: array
    required: true
    description: (delay-ms type code value sync) tuples, or (period 254 steps x y) glides
```

## tests/endpoint-boundary/module/Kconfig
```kconfig
# SPDX-License-Identifier: MIT
config ZMK_INPUT_INERTIA_TEST
    bool "Enable inertia hooks for the endpoint boundary fixture"
    depends on ZMK_INPUT_PROCESSOR_INERTIA
```

## tests/integration/dya/west.yml
```yaml
# Copyright (c) 2026 amgskobo
# SPDX-License-Identifier: MIT

manifest:
  remotes:
    - name: cormoran
      url-base: https://github.com/cormoran
  projects:
    - name: zmk
      remote: cormoran
      revision: main+dya
      import: app/west.yml
      clone-depth: 1
    - name: zmk-feature-custom-settings
      remote: cormoran
      revision: c6a7fef3a3be3d3ace5de9a4b0628c6418cd1f3f
  self:
    path: config
```

## tests/integration/module/Kconfig
```kconfig
# Copyright (c) 2026 amgskobo
# SPDX-License-Identifier: MIT

config ZMK_INPUT_INERTIA_TEST
    bool "Run inertia runtime self-tests"
    depends on ZMK_INPUT_PROCESSOR_INERTIA
```

## tests/integration/upstream/west.yml
```yaml
# Copyright (c) 2026 amgskobo
# SPDX-License-Identifier: MIT

manifest:
  remotes:
    - name: zmkfirmware
      url-base: https://github.com/zmkfirmware
  projects:
    - name: zmk
      remote: zmkfirmware
      revision: main
      import: app/west.yml
      clone-depth: 1
  self:
    path: config
```
