/* SPDX-License-Identifier: MIT */
/ {
    limit_first { compatible = "zmk,input-listener"; device = <&kscan>;
        input-processors = <&inertia_runtime_test>;
    };
    limit_second { compatible = "zmk,input-listener"; device = <&kscan>;
        input-processors = <&independent_runtime>;
        child { layers = <1>; input-processors = <&inertia_runtime_test>; };
    };
};
